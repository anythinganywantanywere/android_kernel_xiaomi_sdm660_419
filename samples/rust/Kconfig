## samples/rust/Kconfig
```kconfig
# SPDX-License-Identifier: GPL-2.0
# Only MINIMAL, without PRINT/HOSTPROGS from the reference.

menuconfig SAMPLES_RUST
	bool "Rust samples"
	depends on RUST
	help
	  You can build sample Rust kernel code here.

	  If unsure, say N.

if SAMPLES_RUST

config SAMPLE_RUST_MINIMAL
	tristate "Minimal"
	help
	  This option builds the Rust minimal module sample.

	  To compile this as a module, choose M here:
	  the module will be called rust_minimal.

	  If unsure, say N.

endif # SAMPLES_RUST
```
